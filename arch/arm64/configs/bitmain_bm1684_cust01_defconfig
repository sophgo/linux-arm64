## arch/arm64/configs/bitmain_bm1684_cust01_defconfig
```kconfig
CONFIG_IP_MULTIPLE_TABLES=y
CONFIG_XFRM_STATISTICS=y
CONFIG_BPF_JIT=y
CONFIG_NET_CLS_ACT=y
CONFIG_NET_CLS_BPF=m
CONFIG_NET_ACT_BPF=m
CONFIG_BPF_EVENTS=y
CONFIG_KPROBES=y
CONFIG_KPROBE_EVENT=y
CONFIG_FANOTIFY=y

CONFIG_NET_SCH_CBQ=m
CONFIG_NET_SCH_HTB=m
CONFIG_NET_SCH_HFSC=m
CONFIG_NET_SCH_PRIO=m
CONFIG_NET_SCH_MULTIQ=m
CONFIG_NET_SCH_RED=m
CONFIG_NET_SCH_SFB=m
CONFIG_NET_SCH_SFQ=m
CONFIG_NET_SCH_TEQL=m
CONFIG_NET_SCH_TBF=m
CONFIG_NET_SCH_GRED=m
CONFIG_NET_SCH_DSMARK=m
CONFIG_NET_SCH_NETEM=m
CONFIG_NET_SCH_DRR=m
CONFIG_NET_SCH_MQPRIO=m
CONFIG_NET_SCH_CHOKE=m
CONFIG_NET_SCH_QFQ=m
CONFIG_NET_SCH_CODEL=m
CONFIG_NET_SCH_FQ_CODEL=m
CONFIG_NET_SCH_FQ=m
CONFIG_NET_SCH_HHF=m
CONFIG_NET_SCH_PIE=m
CONFIG_NET_SCH_INGRESS=m
CONFIG_NET_SCH_PLUG=m

CONFIG_CAN=y
CONFIG_CAN_DEV=m
CONFIG_CAN_GS_USB=m

CONFIG_CRYPTO_PCRYPT=m
CONFIG_CRYPTO_DEFLATE=m
CONFIG_ISCSI_TCP=m
CONFIG_IP_ADVANCED_ROUTER=y
```

## arch/arm64/configs/bitmain_bm1684_minimum_defconfig
```kconfig
CONFIG_ARCH_SOPHGO=y
CONFIG_ARCH_BM1684=y
CONFIG_ARM64_ERRATUM_843419=n
CONFIG_BLK_DEV_INITRD=y
CONFIG_COMPAT=y
CONFIG_CRASH_DUMP=y
CONFIG_DEBUG_FS=y
CONFIG_DEBUG_INFO=y
CONFIG_DEBUG_KERNEL=y
CONFIG_DEVTMPFS=y
CONFIG_DEVTMPFS_MOUNT=y
CONFIG_DYNAMIC_DEBUG=y
CONFIG_FHANDLE=y
CONFIG_HIGH_RES_TIMERS=y
CONFIG_KEXEC=y
CONFIG_LOCALVERSION="-bm1686"
CONFIG_MAGIC_SYSRQ=y
CONFIG_MODULES=y
CONFIG_MODULE_UNLOAD=y
CONFIG_MODVERSIONS=y
CONFIG_NO_HZ_IDLE=y
CONFIG_PRINTK_TIME=y
CONFIG_SMP=y
CONFIG_STRICT_DEVMEM=n
CONFIG_TMPFS=y
CONFIG_TRANSPARENT_HUGEPAGE=y

# above are necessary configs for a minimal kernel
# please add other configs down here by function group

# debug
CONFIG_GENERIC_IRQ_DEBUGFS=y

# basic network
CONFIG_NET=y
CONFIG_INET=y
CONFIG_PACKET=y
CONFIG_PACKET_DIAG=y
CONFIG_UNIX=y
CONFIG_NETDEVICES=y
CONFIG_NET_SCHED=y
CONFIG_FIXED_PHY=y
CONFIG_MARVELL_PHY=y
CONFIG_BROADCOM_PHY=y

# NFS boot
CONFIG_IP_PNP=y
CONFIG_NFS_FS=y
CONFIG_ROOT_NFS=y
```

## arch/arm64/configs/bitmain_bm1684_normal_defconfig
```kconfig
CONFIG_ARCH_BITMAIN=y
CONFIG_ARCH_BM1684=y
CONFIG_ARM64_ERRATUM_843419=n
CONFIG_ATA=y
CONFIG_BLK_CGROUP=y
CONFIG_BLK_DEV_BSGLIB=y
CONFIG_BLK_DEV_DM=y
CONFIG_BLK_DEV_INITRD=y
CONFIG_BLK_DEV_LOOP=y
CONFIG_BLK_DEV_NVME=y
CONFIG_BLK_DEV_NVME_SCSI=y
CONFIG_BLK_DEV_RAM=y
CONFIG_BLK_DEV_RAM_SIZE=65536
CONFIG_BLK_DEV_SD=y
CONFIG_BLK_DEV_THROTTLING=y
CONFIG_BM_MCU=y
CONFIG_BM_MCU_EEPROM=y
CONFIG_BM_MCU_KEYPAD=y
CONFIG_BM_MCU_PIC=y
CONFIG_BM_MCU_WATCHDOG=y
CONFIG_BM_WATCHDOG=y
CONFIG_BM_CPU_DRV=y
CONFIG_BPF_SYSCALL=y
CONFIG_BRIDGE=y
CONFIG_BRIDGE_EBT_802_3=y
CONFIG_BRIDGE_EBT_AMONG=y
CONFIG_BRIDGE_EBT_ARP=y
CONFIG_BRIDGE_EBT_ARPREPLY=y
CONFIG_BRIDGE_EBT_BROUTE=y
CONFIG_BRIDGE_EBT_DNAT=y
CONFIG_BRIDGE_EBT_IP6=y
CONFIG_BRIDGE_EBT_IP=y
CONFIG_BRIDGE_EBT_LIMIT=y
CONFIG_BRIDGE_EBT_LOG=y
CONFIG_BRIDGE_EBT_MARK=y
CONFIG_BRIDGE_EBT_MARK_T=y
CONFIG_BRIDGE_EBT_NFLOG=y
CONFIG_BRIDGE_EBT_PKTTYPE=y
CONFIG_BRIDGE_EBT_REDIRECT=y
CONFIG_BRIDGE_EBT_SNAT=y
CONFIG_BRIDGE_EBT_STP=y
CONFIG_BRIDGE_EBT_T_FILTER=y
CONFIG_BRIDGE_EBT_T_NAT=y
CONFIG_BRIDGE_EBT_VLAN=y
CONFIG_BRIDGE_NETFILTER=m
CONFIG_BRIDGE_NF_EBTABLES=y
CONFIG_BROADCOM_PHY=y
CONFIG_BT=m
CONFIG_BT_HIDP=y
CONFIG_BT_LEDS=y
CONFIG_BT_HCIBTUSB=y
CONFIG_BT_RTL8822BU=m
CONFIG_BT_RFCOMM=m
CONFIG_BT_RFCOMM_TTY=y
CONFIG_BT_BNEP=m
CONFIG_BT_BNEP_MC_FILTER=y
CONFIG_BT_BNEP_PROTO_FILTER=y
CONFIG_BTRFS_FS=y
CONFIG_BTRFS_FS_POSIX_ACL=y
CONFIG_CFG80211=y
CONFIG_CFG80211_WEXT=y
CONFIG_CFQ_GROUP_IOSCHED=y
CONFIG_CFS_BANDWIDTH=y
CONFIG_CGROUP_CPUACCT=y
CONFIG_CGROUP_DEVICE=y
CONFIG_CGROUP_FREEZER=y
CONFIG_CGROUP_HUGETLB=y
CONFIG_CGROUP_NET_PRIO=y
CONFIG_CGROUP_PERF=y
CONFIG_CGROUP_PIDS=y
CONFIG_CHR_DEV_SG=y
CONFIG_CMA=y
CONFIG_COMPAT=y
CONFIG_CPUSETS=y
CONFIG_CPU_FREQ=y
CONFIG_CPU_FREQ_DEFAULT_GOV_PERFORMANCE=y
CONFIG_CPU_FREQ_GOV_PERFORMANCE=y
CONFIG_CRASH_DUMP=y
CONFIG_CRYPTO_CCM=y
CONFIG_CRYPTO_CMAC=y
CONFIG_CRYPTO_ECHAINIV=n
CONFIG_CRYPTO_GCM=y
CONFIG_CRYPTO_USER=y
CONFIG_CRYPTO_USER_API_AEAD=y
CONFIG_CRYPTO_USER_API_HASH=y
CONFIG_CRYPTO_USER_API_RNG=y
CONFIG_CRYPTO_USER_API_SKCIPHER=y
CONFIG_DEBUG_INFO=y
CONFIG_DEBUG_KERNEL=y
CONFIG_DEVTMPFS=y
CONFIG_DEVTMPFS_MOUNT=y
CONFIG_DMABUF_HEAPS=y
CONFIG_DMABUF_HEAPS_CARVEOUT=y
CONFIG_DMABUF_HEAPS_CARVEOUT_DEBUG=y
CONFIG_DMABUF_HEAPS_CMA=y
CONFIG_DMABUF_HEAPS_SYSTEM=y
CONFIG_DMA_CMA=y
CONFIG_DM_BUFIO=y
CONFIG_DM_THIN_PROVISIONING=y
CONFIG_DM_VERITY=y
CONFIG_DRM=y
CONFIG_DRM_TTM=y
CONFIG_DRM_SMI=y
CONFIG_DRM_SMI_HDMI=n
CONFIG_DRM_EVDI=m
CONFIG_DUMMY=y
CONFIG_DYNAMIC_DEBUG=y
CONFIG_EFIVAR_FS=y
CONFIG_ENABLE_DEFAULT_TRACERS=y
CONFIG_ETHERNET=y
CONFIG_EXT2_FS=y
CONFIG_EXT2_FS_XATTR=y
CONFIG_EXT3_FS=y
CONFIG_EXT3_FS_POSIX_ACL=y
CONFIG_EXT3_FS_SECURITY=y
CONFIG_EXT4_FS=y
CONFIG_EXT4_FS_POSIX_ACL=y
CONFIG_EXT4_FS_SECURITY=y
CONFIG_FAT_DEFAULT_CODEPAGE=437
CONFIG_FAT_DEFAULT_IOCHARSET="iso8859-1"
CONFIG_FAT_FS=y
CONFIG_FB_SM750=n
CONFIG_FHANDLE=y
CONFIG_FUSE_FS=y
CONFIG_HIGH_RES_TIMERS=y
CONFIG_HUGETLBFS=y
CONFIG_IKCONFIG=y
CONFIG_IKCONFIG_PROC=y
CONFIG_IMA_KEYRINGS_PERMIT_SIGNED_BY_BUILTIN_OR_SECONDARY=y
CONFIG_INET=y
CONFIG_INET_ESP=y
CONFIG_INPUT_EVDEV=y
CONFIG_INPUT_MATRIXKMAP=y
CONFIG_INTEGRITY_ASYMMETRIC_KEYS=y
CONFIG_INTEGRITY_SIGNATURE=y
CONFIG_IP6_NF_FILTER=y
CONFIG_IP6_NF_MANGLE=y
CONFIG_IP6_NF_MATCH_AH=y
CONFIG_IP6_NF_MATCH_EUI64=y
CONFIG_IP6_NF_MATCH_FRAG=y
CONFIG_IP6_NF_MATCH_HL=y
CONFIG_IP6_NF_MATCH_IPV6HEADER=y
CONFIG_IP6_NF_MATCH_MH=y
CONFIG_IP6_NF_MATCH_OPTS=y
CONFIG_IP6_NF_MATCH_RPFILTER=y
CONFIG_IP6_NF_MATCH_RT=y
CONFIG_IP6_NF_NAT=y
CONFIG_IP6_NF_RAW=y
CONFIG_IP6_NF_SECURITY=y
CONFIG_IP6_NF_TARGET_HL=y
CONFIG_IP6_NF_TARGET_MASQUERADE=y
CONFIG_IP6_NF_TARGET_NPT=y
CONFIG_IP6_NF_TARGET_REJECT=y
CONFIG_IP6_NF_TARGET_SYNPROXY=y
CONFIG_IPVLAN=y
CONFIG_IP_MULTICAST=y
CONFIG_IP_NF_ARPFILTER=y
CONFIG_IP_NF_ARPTABLES=y
CONFIG_IP_NF_ARP_MANGLE=y
CONFIG_IP_NF_FILTER=y
CONFIG_IP_NF_IPTABLES=y
CONFIG_IP_NF_MANGLE=y
CONFIG_IP_NF_MATCH_AH=y
CONFIG_IP_NF_MATCH_ECN=y
CONFIG_IP_NF_MATCH_RPFILTER=y
CONFIG_IP_NF_MATCH_TTL=y
CONFIG_IP_NF_NAT=y
CONFIG_IP_NF_RAW=y
CONFIG_IP_NF_SECURITY=y
CONFIG_IP_NF_TARGET_CLUSTERIP=y
CONFIG_IP_NF_TARGET_ECN=y
CONFIG_IP_NF_TARGET_MASQUERADE=y
CONFIG_IP_NF_TARGET_NETMAP=y
CONFIG_IP_NF_TARGET_REDIRECT=y
CONFIG_IP_NF_TARGET_REJECT=y
CONFIG_IP_NF_TARGET_SYNPROXY=y
CONFIG_IP_NF_TARGET_TTL=y
CONFIG_IP_PNP=y
CONFIG_IP_SET=y
CONFIG_IP_SET_BITMAP_IP=y
CONFIG_IP_SET_BITMAP_IPMAC=y
CONFIG_IP_SET_BITMAP_PORT=y
CONFIG_IP_SET_HASH_IP=y
CONFIG_IP_SET_HASH_IPMARK=y
CONFIG_IP_SET_HASH_IPPORT=y
CONFIG_IP_SET_HASH_IPPORTIP=y
CONFIG_IP_SET_HASH_IPPORTNET=y
CONFIG_IP_SET_HASH_MAC=y
CONFIG_IP_SET_HASH_NET=y
CONFIG_IP_SET_HASH_NETIFACE=y
CONFIG_IP_SET_HASH_NETNET=y
CONFIG_IP_SET_HASH_NETPORT=y
CONFIG_IP_SET_HASH_NETPORTNET=y
CONFIG_IP_SET_LIST_SET=y
CONFIG_IP_VS=y
CONFIG_IP_VS_DEBUG=y
CONFIG_IP_VS_DH=y
CONFIG_IP_VS_FO=y
CONFIG_IP_VS_FTP=y
CONFIG_IP_VS_IPV6=y
CONFIG_IP_VS_LBLC=y
CONFIG_IP_VS_LBLCR=y
CONFIG_IP_VS_LC=y
CONFIG_IP_VS_NFCT=y
CONFIG_IP_VS_NQ=y
CONFIG_IP_VS_OVF=y
CONFIG_IP_VS_PE_SIP=y
CONFIG_IP_VS_PROTO_AH=y
CONFIG_IP_VS_PROTO_ESP=y
CONFIG_IP_VS_PROTO_SCTP=y
CONFIG_IP_VS_PROTO_TCP=y
CONFIG_IP_VS_PROTO_UDP=y
CONFIG_IP_VS_RR=y
CONFIG_IP_VS_SED=y
CONFIG_IP_VS_SH=y
CONFIG_IP_VS_WLC=y
CONFIG_IP_VS_WRR=y
CONFIG_GENERIC_IRQ_DEBUGFS=y
CONFIG_ISO9660_FS=y
CONFIG_JOLIET=y
CONFIG_KEXEC=y
CONFIG_KEYBOARD_GPIO=y
CONFIG_KEYBOARD_GPIO_POLLED=y
CONFIG_KEYS=y
CONFIG_KVM=y
CONFIG_LEDS_CLASS=y
CONFIG_LEDS_GPIO=y
CONFIG_LEDS_TRIGGERS=y
CONFIG_LOCALVERSION="-bm1684"
CONFIG_MAC80211=y
CONFIG_MACVLAN=y
CONFIG_MAGIC_SYSRQ=y
CONFIG_MARVELL_PHY=y
CONFIG_MD=y
CONFIG_MEDIA_CAMERA_SUPPORT=y
CONFIG_MEDIA_SUPPORT=y
CONFIG_MEDIA_USB_SUPPORT=y
CONFIG_MEMCG=y
CONFIG_MEMCG_SWAP=y
CONFIG_MMC_BLOCK_MINORS=8
CONFIG_MODULES=y
CONFIG_MODULE_UNLOAD=y
CONFIG_POWER_RESET_GPIO=y
CONFIG_MODVERSIONS=y
CONFIG_MSDOS_FS=y
CONFIG_NET=y
CONFIG_NETDEVICES=y
CONFIG_NETFILTER=y
CONFIG_NETFILTER_NETLINK_GLUE_CT=y
CONFIG_NETFILTER_XT_MATCH_ADDRTYPE=y
CONFIG_NETFILTER_XT_MATCH_BPF=y
CONFIG_NETFILTER_XT_MATCH_CGROUP=y
CONFIG_NETFILTER_XT_MATCH_CLUSTER=y
CONFIG_NETFILTER_XT_MATCH_COMMENT=y
CONFIG_NETFILTER_XT_MATCH_CONNBYTES=y
CONFIG_NETFILTER_XT_MATCH_CONNLABEL=y
CONFIG_NETFILTER_XT_MATCH_CONNLIMIT=y
CONFIG_NETFILTER_XT_MATCH_CONNMARK=y
CONFIG_NETFILTER_XT_MATCH_CONNTRACK=y
CONFIG_NETFILTER_XT_MATCH_CPU=y
CONFIG_NETFILTER_XT_MATCH_DCCP=y
CONFIG_NETFILTER_XT_MATCH_DEVGROUP=y
CONFIG_NETFILTER_XT_MATCH_DSCP=y
CONFIG_NETFILTER_XT_MATCH_ECN=y
CONFIG_NETFILTER_XT_MATCH_ESP=y
CONFIG_NETFILTER_XT_MATCH_HASHLIMIT=y
CONFIG_NETFILTER_XT_MATCH_HELPER=y
CONFIG_NETFILTER_XT_MATCH_HL=y
CONFIG_NETFILTER_XT_MATCH_IPCOMP=y
CONFIG_NETFILTER_XT_MATCH_IPRANGE=y
CONFIG_NETFILTER_XT_MATCH_IPVS=y
CONFIG_NETFILTER_XT_MATCH_L2TP=y
CONFIG_NETFILTER_XT_MATCH_LENGTH=y
CONFIG_NETFILTER_XT_MATCH_LIMIT=y
CONFIG_NETFILTER_XT_MATCH_MAC=y
CONFIG_NETFILTER_XT_MATCH_MARK=y
CONFIG_NETFILTER_XT_MATCH_MULTIPORT=y
CONFIG_NETFILTER_XT_MATCH_NFACCT=y
CONFIG_NETFILTER_XT_MATCH_OSF=y
CONFIG_NETFILTER_XT_MATCH_OWNER=y
CONFIG_NETFILTER_XT_MATCH_PHYSDEV=y
CONFIG_NETFILTER_XT_MATCH_PKTTYPE=y
CONFIG_NETFILTER_XT_MATCH_POLICY=y
CONFIG_NETFILTER_XT_MATCH_QUOTA=y
CONFIG_NETFILTER_XT_MATCH_RATEEST=y
CONFIG_NETFILTER_XT_MATCH_REALM=y
CONFIG_NETFILTER_XT_MATCH_RECENT=y
CONFIG_NETFILTER_XT_MATCH_SCTP=y
CONFIG_NETFILTER_XT_MATCH_SOCKET=y
CONFIG_NETFILTER_XT_MATCH_STATE=y
CONFIG_NETFILTER_XT_MATCH_STATISTIC=y
CONFIG_NETFILTER_XT_MATCH_STRING=y
CONFIG_NETFILTER_XT_MATCH_TCPMSS=y
CONFIG_NETFILTER_XT_MATCH_TIME=y
CONFIG_NETFILTER_XT_MATCH_U32=y
CONFIG_NETFILTER_XT_SET=y
CONFIG_NETFILTER_XT_TARGET_CHECKSUM=y
CONFIG_NETFILTER_XT_TARGET_CLASSIFY=y
CONFIG_NETFILTER_XT_TARGET_CONNMARK=y
CONFIG_NETFILTER_XT_TARGET_DSCP=y
CONFIG_NETFILTER_XT_TARGET_HMARK=y
CONFIG_NETFILTER_XT_TARGET_IDLETIMER=y
CONFIG_NETFILTER_XT_TARGET_LOG=y
CONFIG_NETFILTER_XT_TARGET_MARK=y
CONFIG_NETFILTER_XT_TARGET_NETMAP=y
CONFIG_NETFILTER_XT_TARGET_NFLOG=y
CONFIG_NETFILTER_XT_TARGET_NFQUEUE=y
CONFIG_NETFILTER_XT_TARGET_NOTRACK=y
CONFIG_NETFILTER_XT_TARGET_REDIRECT=y
CONFIG_NETFILTER_XT_TARGET_TCPMSS=y
CONFIG_NETFILTER_XT_TARGET_TCPOPTSTRIP=y
CONFIG_NETFILTER_XT_TARGET_TEE=y
CONFIG_NETFILTER_XT_TARGET_TPROXY=y
CONFIG_NETFILTER_XT_TARGET_TRACE=y
CONFIG_NET_CLS_CGROUP=y
CONFIG_NET_L3_MASTER_DEV=y
CONFIG_NET_SCHED=y
CONFIG_NET_VENDOR_STMICRO=y
CONFIG_NEW_LEDS=y
CONFIG_NFS_FS=y
CONFIG_NFSD=y
CONFIG_NFSD_V3=y
CONFIG_NFSD_V4=y
CONFIG_NFT_BRIDGE_META=y
CONFIG_NFT_BRIDGE_REJECT=y
CONFIG_NFT_CHAIN_NAT_IPV4=y
CONFIG_NFT_CHAIN_NAT_IPV6=y
CONFIG_NFT_CHAIN_ROUTE_IPV4=y
CONFIG_NFT_CHAIN_ROUTE_IPV6=y
CONFIG_NFT_COMPAT=y
CONFIG_NFT_COUNTER=y
CONFIG_NFT_CT=y
CONFIG_NFT_DUP_IPV4=y
CONFIG_NFT_DUP_IPV6=y
CONFIG_NFT_DUP_NETDEV=y
CONFIG_NFT_EXTHDR=y
CONFIG_NFT_FWD_NETDEV=y
CONFIG_NFT_HASH=y
CONFIG_NFT_LIMIT=y
CONFIG_NFT_LOG=y
CONFIG_NFT_MASQ=y
CONFIG_NFT_MASQ_IPV4=y
CONFIG_NFT_MASQ_IPV6=y
CONFIG_NFT_META=y
CONFIG_NFT_NAT=y
CONFIG_NFT_NUMGEN=y
CONFIG_NFT_QUEUE=y
CONFIG_NFT_QUOTA=y
CONFIG_NFT_REDIR=y
CONFIG_NFT_REDIR_IPV4=y
CONFIG_NFT_REDIR_IPV6=y
CONFIG_NFT_REJECT=y
CONFIG_NFT_SET_HASH=y
CONFIG_NFT_SET_RBTREE=y
CONFIG_NF_CONNTRACK=y
CONFIG_NF_CONNTRACK_AMANDA=y
CONFIG_NF_CONNTRACK_EVENTS=y
CONFIG_NF_CONNTRACK_FTP=y
CONFIG_NF_CONNTRACK_H323=y
CONFIG_NF_CONNTRACK_IPV4=y
CONFIG_NF_CONNTRACK_IPV6=y
CONFIG_NF_CONNTRACK_IRC=y
CONFIG_NF_CONNTRACK_NETBIOS_NS=y
CONFIG_NF_CONNTRACK_PPTP=y
CONFIG_PREEMPT_NONE=y
CONFIG_NF_CONNTRACK_SANE=y
CONFIG_NF_CONNTRACK_SIP=y
CONFIG_NF_CONNTRACK_SNMP=y
CONFIG_NF_CONNTRACK_TFTP=y
CONFIG_NF_CONNTRACK_TIMEOUT=y
CONFIG_NF_CONNTRACK_TIMESTAMP=y
CONFIG_NF_CONNTRACK_ZONES=y
CONFIG_NF_CT_NETLINK=y
CONFIG_NF_CT_NETLINK_HELPER=y
CONFIG_NF_CT_NETLINK_TIMEOUT=y
CONFIG_NF_CT_PROTO_DCCP=y
CONFIG_NF_CT_PROTO_SCTP=y
CONFIG_NF_CT_PROTO_UDPLITE=y
CONFIG_NF_LOG_ARP=y
CONFIG_NF_LOG_BRIDGE=y
CONFIG_NF_NAT_IPV4=y
CONFIG_NF_NAT_MASQUERADE_IPV4=y
CONFIG_NF_TABLES=y
CONFIG_NF_TABLES_ARP=y
CONFIG_NF_TABLES_BRIDGE=y
CONFIG_NF_TABLES_INET=y
CONFIG_NF_TABLES_NETDEV=y
CONFIG_NLS=y
CONFIG_NLS_CODEPAGE_437=y
CONFIG_NLS_CODEPAGE_850=y
CONFIG_NLS_DEFAULT="iso8859-1"
CONFIG_NLS_ISO8859_1=y
CONFIG_NLS_ISO8859_2=y
CONFIG_NLS_ISO8859_3=y
CONFIG_NLS_UTF8=y
CONFIG_NO_HZ_IDLE=y
CONFIG_NTFS_FS=y
CONFIG_NTFS_RW=y
CONFIG_OVERLAY_FS=y
CONFIG_OVERLAY_FS_INDEX=y
CONFIG_OVERLAY_FS_NFS_EXPORT=y
CONFIG_PACKET=y
CONFIG_PACKET_DIAG=y
CONFIG_PM_DEBUG=y
CONFIG_PM_SLEEP_DEBUG=y
CONFIG_POSIX_MQUEUE=y
CONFIG_PPP=y
CONFIG_PPPOATM=y
CONFIG_PPPOE=y
CONFIG_PPPOL2TP=y
CONFIG_PPP_ASYNC=y
CONFIG_PPP_BSDCOMP=y
CONFIG_PPP_DEFLATE=y
CONFIG_PPP_FILTER=y
CONFIG_PPP_MPPE=y
CONFIG_PPP_MULTILINK=y
CONFIG_PPP_SYNC_TTY=y
CONFIG_PPTP=y
CONFIG_PRINTK_TIME=y
CONFIG_PROFILING=y
CONFIG_PSTORE=y
CONFIG_PSTORE_CONSOLE=y
CONFIG_PSTORE_PMSG=y
CONFIG_PSTORE_RAM=y
CONFIG_PSTORE_ZLIB_COMPRESS=y
CONFIG_PTP_1588_CLOCK=n
CONFIG_REALTEK_PHY=y
CONFIG_RFKILL=y
CONFIG_ROOT_NFS=y
CONFIG_RTC_CLASS=y
CONFIG_RTC_DRV_DS1307=y
CONFIG_RTC_DRV_HYM8563=y
CONFIG_RTL_CARDS=y
CONFIG_RT_GROUP_SCHED=n
CONFIG_SATA_AHCI=y
CONFIG_SCHED_AUTOGROUP=y
CONFIG_SECCOMP=y
CONFIG_SECONDARY_TRUSTED_KEYRING=y
CONFIG_SECURITY=y
CONFIG_SENSORS_LM90=y
CONFIG_SENSORS_PWM_FAN=y
CONFIG_SMP=y
CONFIG_SND=y
CONFIG_SND_USB_AUDIO=y
CONFIG_SOUND=y
CONFIG_SQUASHFS=y
CONFIG_STAGING=y
CONFIG_STRICT_DEVMEM=n
CONFIG_SYSTEM_TRUSTED_KEYRING=y
CONFIG_SYSVIPC=y
CONFIG_TASKSTATS=y
CONFIG_THERMAL=y
CONFIG_THERMAL_HWMON=y
CONFIG_TMPFS=y
CONFIG_TRANSPARENT_HUGEPAGE=y
CONFIG_TRANSPARENT_HUGEPAGE_MADVISE=y
CONFIG_TUN=y
CONFIG_UNIX=y
CONFIG_USB=y
CONFIG_USB_USBNET=y
CONFIG_USB_NET_QMI_WWAN=y
CONFIG_USB_ACM=y
CONFIG_USB_ANNOUNCE_NEW_DEVICES=y
CONFIG_USB_EHCI_HCD=y
CONFIG_USB_FL2000=m
CONFIG_USB_RTL8152=y
CONFIG_USB_SERIAL=y
CONFIG_USB_SERIAL_CP210X=y
CONFIG_USB_SERIAL_GENERIC=y
CONFIG_USB_SERIAL_OPTION=y
CONFIG_USB_SERIAL_PL2303=y
CONFIG_USB_SERIAL_WWAN=y
CONFIG_USB_STORAGE=y
CONFIG_USB_VIDEO_CLASS=y
CONFIG_USB_XHCI_HCD=y
CONFIG_USER_NS=y
CONFIG_VETH=y
CONFIG_VFAT_FS=y
CONFIG_VIDEO_V4L2=y
CONFIG_VIRTUALIZATION=y
CONFIG_VXLAN=y
CONFIG_XFRM_USER=y
CONFIG_ZISOFS=y
CONFIG_NET_VENDOR_REALTEK=y
CONFIG_BONDING=m
CONFIG_R8169=m
CONFIG_REALTEK_R8125=m
CONFIG_BMPERF_BM1684=m
CONFIG_CRYPTO_OFB=y
CONFIG_CRYPTO_SM4=y
CONFIG_CRYPTO_SM3=y
CONFIG_THERMAL_WRITABLE_TRIPS=y
CONFIG_WLAN=y
CONFIG_WLAN_VENDOR_REALTEK=y
CONFIG_RTL8192CU=m
CONFIG_RTL8XXXU=m
CONFIG_RTL8822BU=m
CONFIG_SOPHGO_VETH=y
CONFIG_GPIO_PCA953X=y
```

## arch/arm64/configs/sophgo_mango_normal_defconfig
```kconfig
CONFIG_ARCH_SOPHGO=y
CONFIG_ARCH_MANGO=y
CONFIG_ARM64_ERRATUM_843419=n
CONFIG_BLK_DEV_INITRD=y
CONFIG_COMPAT=y
CONFIG_CRASH_DUMP=y
CONFIG_DEBUG_FS=y
CONFIG_DEBUG_INFO=y
CONFIG_DEBUG_KERNEL=y
CONFIG_DEVTMPFS=y
CONFIG_DEVTMPFS_MOUNT=y
CONFIG_DYNAMIC_DEBUG=y
CONFIG_DMA_SHARED_BUFFER=y
CONFIG_DMABUF_HEAPS=y
CONFIG_DMABUF_HEAPS_CARVEOUT=y
CONFIG_DMABUF_HEAPS_CARVEOUT_DEBUG=y
CONFIG_FHANDLE=y
CONFIG_HIGH_RES_TIMERS=y
CONFIG_KEXEC=y
CONFIG_LOCALVERSION="-mango"
CONFIG_MAGIC_SYSRQ=y
CONFIG_MODULES=y
CONFIG_MODULE_UNLOAD=y
CONFIG_MODVERSIONS=y
CONFIG_NO_HZ_IDLE=y
CONFIG_PRINTK_TIME=y
CONFIG_SMP=y
CONFIG_STRICT_DEVMEM=n
CONFIG_TMPFS=y
CONFIG_TRANSPARENT_HUGEPAGE=y

# above are necessary configs for a minimal kernel
# please add other configs down here by function group

# pcie
CONFIG_PCI=y
CONFIG_PCI_DOMAINS=y
CONFIG_PCIEPORTBUS=y
CONFIG_PCI_MSI_IRQ_DOMAIN=y
CONFIG_PCIE_CADENCE=y
CONFIG_PCIE_CADENCE_MANGO=y

# basic network
CONFIG_NET=y
CONFIG_INET=y
CONFIG_PACKET=y
CONFIG_PACKET_DIAG=y
CONFIG_UNIX=y
CONFIG_NETDEVICES=y
CONFIG_ETHOC=y
CONFIG_NET_VENDOR_REALTEK=y
CONFIG_R8169=y

# debug
CONFIG_GENERIC_IRQ_DEBUGFS=y
```

## drivers/bluetooth/rtl8822bu_usb/Kconfig
```kconfig
config BT_RTL8822BU
	tristate "RTL8822BU Bluetooth USB driver"
	depends on USB && !BT_HCIBTUSB
	select FW_LOADER
```
