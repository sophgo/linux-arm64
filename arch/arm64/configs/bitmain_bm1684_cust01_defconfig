## drivers/dma-buf/heaps/Kconfig
```kconfig
config DMABUF_HEAPS_SYSTEM
	bool "DMA-BUF System Heap"
	depends on DMABUF_HEAPS
	help
	  Choose this option to enable the system dmabuf heap. The system heap
	  is backed by pages from the buddy allocator. If in doubt, say Y.

config DMABUF_HEAPS_CMA
	bool "DMA-BUF CMA Heap"
	depends on DMABUF_HEAPS && DMA_CMA
	help
	  Choose this option to enable dma-buf CMA heap. This heap is backed
	  by the Contiguous Memory Allocator (CMA). If your system has these
	  regions, you should say Y here.

config DMABUF_HEAPS_CARVEOUT
	bool "DMA-BUF Carveout Heap"
	depends on DMABUF_HEAPS && OF_RESERVED_MEM
	select GENERIC_ALLOCATOR
	help
	  Choose this option to enable dma-buf carveout heap. This heap is
	  backed by reserved memory and generic allocator.

config DMABUF_HEAPS_CARVEOUT_DEBUG
	bool "Debug feature for carveout heap"
	depends on DMABUF_HEAPS_CARVEOUT
	help
	  Choose this option to enable debug help functions for carveout heap,
	  such as buffer statistic.
```

## drivers/net/ethernet/realtek/r8125/Kconfig
```kconfig
config REALTEK_R8125
	tristate "RealTek 8125 gigabit ethernet sipport"
    depends on PCI
	default y
	---help---
		Say Y here if you have a Realtek 8125 PCI Gigabit Ethernet adapter.

		To compile this driver as a module, choose M here: the module
		will be called r8125.  This is recommended.
```

## drivers/soc/bitmain/Kconfig
```kconfig
#
# Bitmain SoC drivers
#

if ARCH_BITMAIN
menu "Sophon SoC drivers"

config ARCH_BM1684
	bool "Sophon BM1684 SoC"
	select PINCTRL
	select GENERIC_PINCONF
	select COMMON_CLK
	select RESET_CONTROLLER
	select MFD_SYSCON
        select PWM
	select PWM_SYSFS
	select WATCHDOG
	select DW_WATCHDOG
	select DW_APB_TIMER
	select DW_APB_TIMER_OF
	select DMADEVICES
	select DMA_SHARED_BUFFER
	select PCI
	select PCIE_DW
	select PCIE_DW_HOST
	select MMC
	select MMC_SDHCI
	select MMC_SDHCI_PLTFM
	select STMMAC_ETH
	select STMMAC_PLATFORM
	select STMMAC_SELFTESTS
	select I2C
	select I2C_CHARDEV
	select I2C_DESIGNWARE_CORE
	select I2C_DESIGNWARE_PLATFORM
	select GPIOLIB
	select GPIO_SYSFS
	select GPIO_DWAPB
	select HWSPINLOCK
	select SERIAL_8250
	select SERIAL_8250_CONSOLE
	select SERIAL_8250_DW
	select HW_RANDOM_DWC_CLP890
	select CRYPTO
	select CRYPTO_HW
	select CRYPTO_AES
	select CRYPTO_DES
	select CRYPTO_HASH
	select CRYPTO_BLKCIPHER
	select CRYPTO_ENGINE
	select CRYPTO_DEV_DWC_PKA
	help
	  This enables support for BM1684

config BM_MCU
	bool "Bitmain MCU i2c driver"
	default n
	help
	  Unified MCU driver. It contains MCU misc functions.

config BM_MCU_WATCHDOG
	bool "Bitmain I2C based watchdog"
	default n
	depends on WATCHDOG && WATCHDOG_CORE
	help
	  Bitmain I2C based watchdog.
	  We call it dummy not because it is not a physicall device, but it is
	  emulated by an MCU. It can maintain a software down counter and
	  auto-reload register. And can can reset SoC in real. I take SA5 in
	  an example. SA5's SoC is bm1684 and its associated MCU is STM32L073xx
	  STM32 uses its i2c controller as slave mode, a special slave address
	  is bind to this watchdog software instance running on STM32. It act
	  as a real watchdog. STM32 can accept multiple slave address
	  transactions at one time. MCU other services should pick another slave
	  address. bm1684 act as an i2c master, with this driver, in linux
	  system, STM32 looks like a standard watchdog device.

config BM_MCU_EEPROM
	bool "Bitmain I2C based EEPROM"
	default n
	select NVMEM
	help
	  Bitmain I2C based EEPROM.
	  This EEPROM is simulated by an STM32 MCU.
	  It supports random-read and random-write with any size.
	  I2C clock stretching should be supported by i2c master.
	  It takes time duing read or write from MCU EEPROM.

config BM_MCU_KEYPAD
	bool "Bitmain I2C based keypad"
	default n
	depends on INPUT_MATRIXKMAP
	help
	  Bitmain I2C based keypad.
	  This virtual keypad is used to send some event to SoC
	  eg. motherboard power key event, reset event...
	  This device is emulated by STM32 linked on SoC i2c bus.
	  But its key event may get from another device located at motherboard.
	  After virtual key event is read from STM32, you should acknowledge STM32
	  to make sure no event will be lost. Measuring time key pressed is not
	  supported by this device.

config BM_MCU_PIC
	bool "PIC device driver for SE5 motherboard"
	default n
	help
	  PIC device driver for SE5 motherboard.
	  Not all functions are implemented here, because some of functions are
	  used by STM32 for controling devices on motherboard, like setup
	  temperature of SoC, heater control, key events get etc. PIC i2c
	  transactions are derived though STM32.

config BM_WATCHDOG
       bool "Bitmain watchdog framework"
       default n
       help
	Strict mode implementation.

config BMPERF_BM1684
	tristate "performance monitor for AXI/TPU/GDMA"
	default m
	help
	  bm performance monitor module.

config BM_CPU_DRV
	tristate "enable a53 when PCIe mode"
	default n
	help
	  PCIe mode use a53 by this driver.

endmenu
endif # ARCH_BITMAIN
```

## drivers/soc/sophgo/Kconfig
```kconfig
#
# Sophgo SoC drivers
#

if ARCH_SOPHGO
menu "Sophgo SoC drivers"

config ARCH_MANGO
	bool "Sophgo Mango SoC"
	select PINCTRL
	select GENERIC_PINCONF
	select COMMON_CLK
	select RESET_CONTROLLER
	select MFD_SYSCON
        select PWM
	select PWM_SYSFS
	select WATCHDOG
	select DW_WATCHDOG
	select DW_APB_TIMER
	select DW_APB_TIMER_OF
	select DMADEVICES
	select PCI
	select PCIE_CADENCE
	select I2C
	select I2C_CHARDEV
	select I2C_DESIGNWARE_CORE
	select I2C_DESIGNWARE_PLATFORM
	select GPIOLIB
	select GPIO_SYSFS
	select GPIO_DWAPB
	select HWSPINLOCK
	select SERIAL_8250
	select SERIAL_8250_CONSOLE
	select SERIAL_8250_DW
	select RTC_LIB
	select RTC_CLASS
	select SPI
	select SPI_DESIGNWARE
	select SPI_DW_MMIO
	help
	  This enables support for Mango

config PLATFORM_DRIVER_RXU
	bool "Sophgo RXU Driver"
	default y if ARCH_MANGO
	help
	  Sophgo RXU driver.
	  It is a accelerator of XMR mining. Key features list below
	  1. Implements randomX calculation
	  2. Auto compare difficulty
	  3. Auto increase nonce
	  4. Report valid nonce

config PLATFORM_DRIVER_FAU
	bool "Sophgo FAU Driver"
	default y if ARCH_MANGO
	help
	  Sophgo FAU driver.
	  It is a accelerator of filecoin mining for P1 step. Key features list below
	  1. Implements merkel calculation
	  2. Implements sdr calculation


endmenu
endif # ARCH_SOPHGO
```

## drivers/video/fl2000/Kconfig
```kconfig
config USB_FL2000
	tristate "FL2000"
	default n
        ---help---
	This enables FL2000 USB HDMI dongle support.
```
