#include "bm1684x.dtsi"
#include "bm1684x_mm_16g.dtsi"
#include "bm1684x_evb.dtsi"

/ {
	/delete-node/ pka@58008000;
	/delete-node/ clp890@50018000;
	info {
		file-name = "bm1684x_sm7m_v1.0.dtb";
	};
};

&clock_init {
	clock-rates = \
		<2300000000>, <950000000>, <800000000>,

		<1000000000>, <1000000000>,
		<2000000000>, <50000000>,
		<100000000>, <100000000>,
		<125000000>, <50000000>,
		<25000000>, <125000000>,
		<50000000>, <25000000>,
		<500000000>, <25000000>,
		<1000000000>, <500000000>,
		<800000000>, <100000000>,
		<250000000>, <250000000>,
		<500000000>, <500000000>,
		<50000000>, <50000000>,
		<50000000>, <50000000>,
		<50000000>, <50000000>,
		<50000000>, <50000000>,
		<100000>, <100000>, <100000>,

		<1000000001>,
		<800000000>, <800000001>,
		<2300000001>, <575000000>;
		};
