&clock_init {
	clock-rates = \
		<2300000000>, <1000000000>, <800000000>,

		<1000000000>, <1000000000>,
		<2000000000>, <50000000>,
		<200000000>, <100000000>,
		<125000000>, <50000000>,
		<25000000>, <125000000>,
		<50000000>, <25000000>,
		<500000000>, <25000000>,
		<1000000000>, <500000000>,
		<800000000>, <100000000>,
		<250000000>, <250000000>,
		<500000000>, <500000000>,
		<50000000>, <50000000>,
		<50000000>, <50000000>,
		<50000000>, <50000000>,
		<50000000>, <50000000>,
		<100000>, <100000>, <100000>,

		<1000000001>,
		<800000000>, <800000001>,
		<2300000001>, <575000000>;
		};

